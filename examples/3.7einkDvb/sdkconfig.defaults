## examples/3.7einkDvb/sdkconfig.defaults
```kconfig
CONFIG_IDF_TARGET="esp32c5"
CONFIG_ESPTOOLPY_FLASHSIZE_4MB=y
CONFIG_PARTITION_TABLE_CUSTOM=y
CONFIG_PARTITION_TABLE_CUSTOM_FILENAME="partitions.csv"
CONFIG_PARTITION_TABLE_OFFSET=0x8000

CONFIG_LWIP_TCP_SND_BUF_DEFAULT=32768

CONFIG_LWIP_TCP_WND_DEFAULT=32768

CONFIG_LWIP_TCP_RECVMBOX_SIZE=25
```
